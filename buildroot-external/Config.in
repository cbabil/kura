## buildroot-external/Config.in
```kconfig
source "$BR2_EXTERNAL_OS_PATH/package/os-config/Config.in"
source "$BR2_EXTERNAL_OS_PATH/package/os-security/Config.in"
```

## buildroot-external/configs/rpi5_defconfig
```kconfig
# Buildroot Configuration for Raspberry Pi 5

# Target Architecture
BR2_aarch64=y

# Target Options
BR2_cortex_a76=y

# Toolchain
BR2_TOOLCHAIN_BUILDROOT_GLIBC=y
BR2_TOOLCHAIN_BUILDROOT_CXX=y
BR2_KERNEL_HEADERS_6_6=y
BR2_ENABLE_LOCALE_PURGE=y
BR2_ENABLE_LOCALE_WHITELIST="C en_US"

# Build Options
BR2_CCACHE=y

# System Configuration
BR2_TARGET_GENERIC_HOSTNAME="falkenos"
BR2_TARGET_GENERIC_ISSUE="Welcome to FalkenOS"
BR2_INIT_SYSTEMD=y
BR2_SYSTEM_BIN_SH_BASH=y
BR2_TARGET_GENERIC_GETTY_PORT="tty1"
BR2_TARGET_GENERIC_GETTY_BAUDRATE_115200=y
BR2_TARGET_GENERIC_ROOT_PASSWD="falken"
BR2_SYSTEM_DHCP="eth0"
BR2_ROOTFS_OVERLAY="$(BR2_EXTERNAL_OS_PATH)/board/rpi5/overlay"
BR2_ROOTFS_POST_BUILD_SCRIPT="$(BR2_EXTERNAL_OS_PATH)/board/rpi5/post-build.sh"
BR2_ROOTFS_POST_IMAGE_SCRIPT="$(BR2_EXTERNAL_OS_PATH)/board/rpi5/post-image.sh"

# Kernel
BR2_LINUX_KERNEL=y
BR2_LINUX_KERNEL_CUSTOM_TARBALL=y
BR2_LINUX_KERNEL_CUSTOM_TARBALL_LOCATION="https://github.com/raspberrypi/linux/archive/refs/tags/stable_20250916.tar.gz"
BR2_LINUX_KERNEL_DEFCONFIG="bcm2711"
BR2_LINUX_KERNEL_DTS_SUPPORT=y
BR2_LINUX_KERNEL_INTREE_DTS_NAME="broadcom/bcm2712-rpi-5-b"
BR2_LINUX_KERNEL_NEEDS_HOST_OPENSSL=y

# Bootloader (U-Boot)
BR2_TARGET_UBOOT=y
BR2_TARGET_UBOOT_BUILD_SYSTEM_KCONFIG=y
BR2_TARGET_UBOOT_CUSTOM_VERSION=y
BR2_TARGET_UBOOT_CUSTOM_VERSION_VALUE="2023.10"
BR2_TARGET_UBOOT_BOARD_DEFCONFIG="rpi_arm64"
BR2_TARGET_UBOOT_NEEDS_DTC=y
BR2_TARGET_UBOOT_FORMAT_BIN=y

# Raspberry Pi Firmware
BR2_PACKAGE_RPI_FIRMWARE=y
BR2_PACKAGE_RPI_FIRMWARE_VARIANT_PI4=y

# Filesystem
BR2_TARGET_ROOTFS_EXT2=y
BR2_TARGET_ROOTFS_EXT2_4=y
BR2_TARGET_ROOTFS_EXT2_SIZE="2G"

# Create SD card image
BR2_PACKAGE_HOST_GENIMAGE=y
BR2_PACKAGE_HOST_DOSFSTOOLS=y
BR2_PACKAGE_HOST_MTOOLS=y

# Python 3
BR2_PACKAGE_PYTHON3=y
BR2_PACKAGE_PYTHON3_PY_PYC=y
BR2_PACKAGE_PYTHON_JINJA2=y
BR2_PACKAGE_PYTHON_PYYAML=y
BR2_PACKAGE_PYTHON_REQUESTS=y
BR2_PACKAGE_PYTHON_SETUPTOOLS=y

# Docker
BR2_PACKAGE_DOCKER_ENGINE=y
BR2_PACKAGE_DOCKER_CLI=y
BR2_PACKAGE_CONTAINERD=y
BR2_PACKAGE_RUNC=y

# Networking
BR2_PACKAGE_NETWORK_MANAGER=y
BR2_PACKAGE_NETWORK_MANAGER_TUI=y
BR2_PACKAGE_OPENSSH=y
BR2_PACKAGE_IPTABLES=y
BR2_PACKAGE_IPROUTE2=y
BR2_PACKAGE_WIRELESS_TOOLS=y
BR2_PACKAGE_WPA_SUPPLICANT=y

# System utilities
BR2_PACKAGE_HTOP=y
BR2_PACKAGE_NANO=y
BR2_PACKAGE_UTIL_LINUX=y
BR2_PACKAGE_UTIL_LINUX_BINARIES=y
BR2_PACKAGE_CA_CERTIFICATES=y

# OTA Updates - disabled until A/B partition layout is implemented
# BR2_PACKAGE_RAUC=y
# BR2_PACKAGE_RAUC_NETWORK=y

# OS packages (from external tree)
BR2_PACKAGE_OS_CONFIG=y
BR2_PACKAGE_OS_SECURITY=y
```

## buildroot-external/configs/straturaos_defconfig
```kconfig
# StraturaOS Buildroot Configuration for Raspberry Pi 5

# Target Architecture
BR2_aarch64=y

# Target Options
BR2_cortex_a76=y

# Toolchain
BR2_TOOLCHAIN_BUILDROOT_GLIBC=y
BR2_TOOLCHAIN_BUILDROOT_CXX=y
BR2_ENABLE_LOCALE_PURGE=y
BR2_ENABLE_LOCALE_WHITELIST="C en_US"

# Build Options
BR2_CCACHE=y

# System Configuration
BR2_TARGET_GENERIC_HOSTNAME="straturaos"
BR2_TARGET_GENERIC_ISSUE="Welcome to StraturaOS"
BR2_INIT_SYSTEMD=y
BR2_SYSTEM_BIN_SH_BASH=y
BR2_TARGET_GENERIC_GETTY_PORT="tty1"
BR2_TARGET_GENERIC_GETTY_BAUDRATE_115200=y
BR2_TARGET_GENERIC_ROOT_PASSWD="stratura"
BR2_SYSTEM_DHCP="eth0"
BR2_ROOTFS_OVERLAY="$(BR2_EXTERNAL_STRATURAOS_PATH)/board/straturaos/overlay"
BR2_ROOTFS_POST_BUILD_SCRIPT="$(BR2_EXTERNAL_STRATURAOS_PATH)/board/straturaos/post-build.sh"
BR2_ROOTFS_POST_IMAGE_SCRIPT="$(BR2_EXTERNAL_STRATURAOS_PATH)/board/straturaos/post-image.sh"

# Kernel
BR2_LINUX_KERNEL=y
BR2_LINUX_KERNEL_CUSTOM_TARBALL=y
BR2_LINUX_KERNEL_CUSTOM_TARBALL_LOCATION="https://github.com/raspberrypi/linux/archive/refs/tags/stable_20250916.tar.gz"
BR2_LINUX_KERNEL_DEFCONFIG="bcm2711"
BR2_LINUX_KERNEL_DTS_SUPPORT=y
BR2_LINUX_KERNEL_INTREE_DTS_NAME="broadcom/bcm2712-rpi-5-b"
BR2_LINUX_KERNEL_NEEDS_HOST_OPENSSL=y

# Bootloader (U-Boot)
BR2_TARGET_UBOOT=y
BR2_TARGET_UBOOT_BUILD_SYSTEM_KCONFIG=y
BR2_TARGET_UBOOT_CUSTOM_VERSION=y
BR2_TARGET_UBOOT_CUSTOM_VERSION_VALUE="2023.10"
BR2_TARGET_UBOOT_BOARD_DEFCONFIG="rpi_arm64"
BR2_TARGET_UBOOT_NEEDS_DTC=y
BR2_TARGET_UBOOT_FORMAT_BIN=y

# Raspberry Pi Firmware
BR2_PACKAGE_RPI_FIRMWARE=y
BR2_PACKAGE_RPI_FIRMWARE_VARIANT_PI4=y

# Filesystem
BR2_TARGET_ROOTFS_EXT2=y
BR2_TARGET_ROOTFS_EXT2_4=y
BR2_TARGET_ROOTFS_EXT2_SIZE="2G"

# Create SD card image
BR2_PACKAGE_HOST_GENIMAGE=y
BR2_PACKAGE_HOST_DOSFSTOOLS=y
BR2_PACKAGE_HOST_MTOOLS=y

# Python 3
BR2_PACKAGE_PYTHON3=y
BR2_PACKAGE_PYTHON3_PY_PYC=y
BR2_PACKAGE_PYTHON_DOCKER=y
BR2_PACKAGE_PYTHON_REQUESTS=y
BR2_PACKAGE_PYTHON_SETUPTOOLS=y

# Docker
BR2_PACKAGE_DOCKER_ENGINE=y
BR2_PACKAGE_DOCKER_CLI=y
BR2_PACKAGE_CONTAINERD=y
BR2_PACKAGE_RUNC=y

# Networking
BR2_PACKAGE_NETWORK_MANAGER=y
BR2_PACKAGE_NETWORK_MANAGER_TUI=y
BR2_PACKAGE_OPENSSH=y
BR2_PACKAGE_IPTABLES=y
BR2_PACKAGE_IPROUTE2=y
BR2_PACKAGE_WIRELESS_TOOLS=y
BR2_PACKAGE_WPA_SUPPLICANT=y

# System utilities
BR2_PACKAGE_HTOP=y
BR2_PACKAGE_NANO=y
BR2_PACKAGE_UTIL_LINUX=y
BR2_PACKAGE_UTIL_LINUX_BINARIES=y

# OTA Updates
BR2_PACKAGE_RAUC=y
BR2_PACKAGE_RAUC_NETWORK=y

# StraturaOS packages (from external tree)
BR2_PACKAGE_STRATURA_SUPERVISOR=y
BR2_PACKAGE_STRATURA_API=y
BR2_PACKAGE_STRATURA_UPDATER=y
BR2_PACKAGE_STRATURA_CONFIG=y
BR2_PACKAGE_STRATURA_MONITOR=y
BR2_PACKAGE_STRATURA_SECURITY=y
```

## buildroot-external/configs/straturaos_x86_64_cloud_defconfig
```kconfig
# StraturaOS Buildroot Configuration for x86_64 Cloud/VM

# Target Architecture
BR2_x86_64=y

# Toolchain
BR2_TOOLCHAIN_BUILDROOT_GLIBC=y
BR2_TOOLCHAIN_BUILDROOT_CXX=y
BR2_ENABLE_LOCALE_PURGE=y
BR2_ENABLE_LOCALE_WHITELIST="C en_US"

# Build Options
BR2_CCACHE=y

# System Configuration
BR2_TARGET_GENERIC_HOSTNAME="straturaos"
BR2_TARGET_GENERIC_ISSUE="Welcome to StraturaOS"
BR2_INIT_SYSTEMD=y
BR2_SYSTEM_BIN_SH_BASH=y
BR2_TARGET_GENERIC_GETTY_PORT="ttyS0"
BR2_TARGET_GENERIC_GETTY_BAUDRATE_115200=y
BR2_TARGET_GENERIC_ROOT_PASSWD="stratura"
BR2_SYSTEM_DHCP="eth0"
BR2_ROOTFS_OVERLAY="$(BR2_EXTERNAL_STRATURAOS_PATH)/board/straturaos-cloud/overlay"
BR2_ROOTFS_POST_BUILD_SCRIPT="$(BR2_EXTERNAL_STRATURAOS_PATH)/board/straturaos-cloud/post-build.sh"
BR2_ROOTFS_POST_IMAGE_SCRIPT="$(BR2_EXTERNAL_STRATURAOS_PATH)/board/straturaos-cloud/post-image.sh"

# Kernel
BR2_LINUX_KERNEL=y
BR2_LINUX_KERNEL_CUSTOM_VERSION=y
BR2_LINUX_KERNEL_CUSTOM_VERSION_VALUE="6.6.50"
BR2_LINUX_KERNEL_DEFCONFIG="x86_64"
BR2_LINUX_KERNEL_CONFIG_FRAGMENT_FILES="$(BR2_EXTERNAL_STRATURAOS_PATH)/board/straturaos-cloud/linux-extras.config"
BR2_LINUX_KERNEL_NEEDS_HOST_OPENSSL=y

# Bootloader (GRUB2 for EFI)
BR2_TARGET_GRUB2=y
BR2_TARGET_GRUB2_X86_64_EFI=y
BR2_TARGET_GRUB2_BUILTIN_MODULES_EFI="boot linux ext2 fat part_msdos part_gpt normal efi_gop"

# Filesystem
BR2_TARGET_ROOTFS_EXT2=y
BR2_TARGET_ROOTFS_EXT2_4=y
BR2_TARGET_ROOTFS_EXT2_SIZE="4G"
BR2_TARGET_ROOTFS_TAR=y

# Host tools for image creation
BR2_PACKAGE_HOST_GENIMAGE=y
BR2_PACKAGE_HOST_DOSFSTOOLS=y
BR2_PACKAGE_HOST_MTOOLS=y
BR2_PACKAGE_HOST_QEMU=y

# Cloud-init dependencies
BR2_PACKAGE_PYTHON3=y
BR2_PACKAGE_PYTHON3_PY_PYC=y
BR2_PACKAGE_PYTHON_JINJA2=y
BR2_PACKAGE_PYTHON_PYYAML=y
BR2_PACKAGE_PYTHON_REQUESTS=y
BR2_PACKAGE_PYTHON_SETUPTOOLS=y

# Docker
BR2_PACKAGE_DOCKER_ENGINE=y
BR2_PACKAGE_DOCKER_CLI=y
BR2_PACKAGE_CONTAINERD=y
BR2_PACKAGE_RUNC=y

# Networking
BR2_PACKAGE_NETWORK_MANAGER=y
BR2_PACKAGE_NETWORK_MANAGER_TUI=y
BR2_PACKAGE_OPENSSH=y
BR2_PACKAGE_DROPBEAR=n
BR2_PACKAGE_IPTABLES=y
BR2_PACKAGE_IPROUTE2=y
BR2_PACKAGE_CURL=y

# System utilities
BR2_PACKAGE_HTOP=y
BR2_PACKAGE_NANO=y
BR2_PACKAGE_UTIL_LINUX=y
BR2_PACKAGE_UTIL_LINUX_BINARIES=y
BR2_PACKAGE_CA_CERTIFICATES=y

# QEMU guest agent for Proxmox
BR2_PACKAGE_QEMU=y
BR2_PACKAGE_QEMU_SYSTEM=n
BR2_PACKAGE_QEMU_LINUX_USER=n

# OTA Updates
BR2_PACKAGE_RAUC=y
BR2_PACKAGE_RAUC_NETWORK=y

# StraturaOS packages (from external tree)
BR2_PACKAGE_STRATURA_SUPERVISOR=y
BR2_PACKAGE_STRATURA_API=y
BR2_PACKAGE_STRATURA_UPDATER=y
BR2_PACKAGE_STRATURA_CONFIG=y
BR2_PACKAGE_STRATURA_MONITOR=y
BR2_PACKAGE_STRATURA_SECURITY=y
```

## buildroot-external/configs/straturaos_x86_64_defconfig
```kconfig
# StraturaOS Buildroot Configuration for x86_64 (ISO/VM)

# Target Architecture
BR2_x86_64=y

# Toolchain
BR2_TOOLCHAIN_BUILDROOT_GLIBC=y
BR2_TOOLCHAIN_BUILDROOT_CXX=y
BR2_KERNEL_HEADERS_6_6=y
BR2_ENABLE_LOCALE_PURGE=y
BR2_ENABLE_LOCALE_WHITELIST="C en_US"

# Build Options
BR2_CCACHE=y

# System Configuration
BR2_TARGET_GENERIC_HOSTNAME="straturaos"
BR2_TARGET_GENERIC_ISSUE="Welcome to StraturaOS"
BR2_INIT_SYSTEMD=y
BR2_SYSTEM_BIN_SH_BASH=y
BR2_TARGET_GENERIC_GETTY_PORT="ttyS0"
BR2_TARGET_GENERIC_GETTY_BAUDRATE_115200=y
BR2_TARGET_GENERIC_ROOT_PASSWD="stratura"
BR2_SYSTEM_DHCP="eth0"
BR2_ROOTFS_OVERLAY="$(BR2_EXTERNAL_STRATURAOS_PATH)/board/straturaos-x86_64/overlay"
BR2_ROOTFS_POST_BUILD_SCRIPT="$(BR2_EXTERNAL_STRATURAOS_PATH)/board/straturaos-x86_64/post-build.sh"
BR2_ROOTFS_POST_IMAGE_SCRIPT="$(BR2_EXTERNAL_STRATURAOS_PATH)/board/straturaos-x86_64/post-image.sh"

# Kernel
BR2_LINUX_KERNEL=y
BR2_LINUX_KERNEL_CUSTOM_VERSION=y
BR2_LINUX_KERNEL_CUSTOM_VERSION_VALUE="6.17.4"
BR2_LINUX_KERNEL_DEFCONFIG="x86_64"
BR2_LINUX_KERNEL_CONFIG_FRAGMENT_FILES="$(BR2_EXTERNAL_STRATURAOS_PATH)/board/straturaos-x86_64/linux-extras.config"
BR2_LINUX_KERNEL_NEEDS_HOST_OPENSSL=y

# Bootloader (GRUB2 for EFI + BIOS)
BR2_TARGET_GRUB2=y
BR2_TARGET_GRUB2_X86_64_EFI=y
BR2_TARGET_GRUB2_BUILTIN_MODULES_EFI="boot linux ext2 fat iso9660 part_msdos part_gpt normal efi_gop"
BR2_TARGET_GRUB2_I386_PC=y
BR2_TARGET_GRUB2_BUILTIN_MODULES_PC="boot linux ext2 fat squash4 part_msdos part_gpt normal biosdisk iso9660"

# Filesystem - squashfs for ISO, tar for Docker
BR2_TARGET_ROOTFS_SQUASHFS=y
BR2_TARGET_ROOTFS_SQUASHFS4_XZ=y
BR2_TARGET_ROOTFS_TAR=y

# Host tools for ISO creation
BR2_PACKAGE_HOST_DOSFSTOOLS=y
BR2_PACKAGE_HOST_MTOOLS=y

# Cloud-init dependencies
BR2_PACKAGE_PYTHON3=y
BR2_PACKAGE_PYTHON3_PY_PYC=y
BR2_PACKAGE_PYTHON_JINJA2=y
BR2_PACKAGE_PYTHON_PYYAML=y
BR2_PACKAGE_PYTHON_REQUESTS=y
BR2_PACKAGE_PYTHON_SETUPTOOLS=y

# Docker
BR2_PACKAGE_DOCKER_ENGINE=y
BR2_PACKAGE_DOCKER_CLI=y
BR2_PACKAGE_CONTAINERD=y
BR2_PACKAGE_RUNC=y

# Networking
BR2_PACKAGE_NETWORK_MANAGER=y
BR2_PACKAGE_NETWORK_MANAGER_TUI=y
BR2_PACKAGE_OPENSSH=y
BR2_PACKAGE_IPTABLES=y
BR2_PACKAGE_IPROUTE2=y
BR2_PACKAGE_LIBCURL=y

# System utilities
BR2_PACKAGE_HTOP=y
BR2_PACKAGE_NANO=y
BR2_PACKAGE_UTIL_LINUX=y
BR2_PACKAGE_UTIL_LINUX_BINARIES=y
BR2_PACKAGE_CA_CERTIFICATES=y

# QEMU guest agent - disabled, add later if needed
# BR2_PACKAGE_QEMU_GUEST_AGENT=y

# OTA Updates - disabled until A/B partition layout is implemented
# BR2_PACKAGE_RAUC=y
# BR2_PACKAGE_RAUC_NETWORK=y

# StraturaOS packages (from external tree)
BR2_PACKAGE_STRATURA_CONFIG=y
BR2_PACKAGE_STRATURA_SECURITY=y
```

## buildroot-external/package/os-config/Config.in
```kconfig
config BR2_PACKAGE_OS_CONFIG
	bool "os-config"
	select BR2_PACKAGE_PYTHON3
	select BR2_PACKAGE_NETWORK_MANAGER
	help
	  Configuration Manager - System configuration and network management.
```

## buildroot-external/package/os-security/Config.in
```kconfig
config BR2_PACKAGE_OS_SECURITY
	bool "os-security"
	select BR2_PACKAGE_PYTHON3
	help
	  Security Hardening - System security policies and hardening.
```

## buildroot-external/package/stratura-api/Config.in
```kconfig
config BR2_PACKAGE_STRATURA_API
	bool "stratura-api"
	select BR2_PACKAGE_PYTHON3
	select BR2_PACKAGE_PYTHON_FASTAPI
	select BR2_PACKAGE_PYTHON_UVICORN
	help
	  StraturaOS API Server - RESTful API for device management.
	  Provides endpoints for status, updates, and container management.
```

## buildroot-external/package/stratura-config/Config.in
```kconfig
config BR2_PACKAGE_STRATURA_CONFIG
	bool "stratura-config"
	select BR2_PACKAGE_PYTHON3
	select BR2_PACKAGE_NETWORK_MANAGER
	help
	  StraturaOS Configuration Manager - System configuration and network management.
```

## buildroot-external/package/stratura-monitor/Config.in
```kconfig
config BR2_PACKAGE_STRATURA_MONITOR
	bool "stratura-monitor"
	select BR2_PACKAGE_PYTHON3
	help
	  StraturaOS System Monitor - Resource monitoring and metrics collection.
```

## buildroot-external/package/stratura-security/Config.in
```kconfig
config BR2_PACKAGE_STRATURA_SECURITY
	bool "stratura-security"
	select BR2_PACKAGE_PYTHON3
	help
	  StraturaOS Security Hardening - System security policies and hardening.
```

## buildroot-external/package/stratura-supervisor/Config.in
```kconfig
config BR2_PACKAGE_STRATURA_SUPERVISOR
	bool "stratura-supervisor"
	select BR2_PACKAGE_PYTHON3
	select BR2_PACKAGE_PYTHON_REQUESTS
	select BR2_PACKAGE_DOCKER_ENGINE
	select BR2_PACKAGE_DOCKER_CLI
	help
	  StraturaOS Supervisor - Container and system orchestration service.
	  Manages Docker containers via CLI, health checks, and system state.
```

## buildroot-external/package/stratura-updater/Config.in
```kconfig
config BR2_PACKAGE_STRATURA_UPDATER
	bool "stratura-updater"
	select BR2_PACKAGE_PYTHON3
	select BR2_PACKAGE_RAUC
	help
	  StraturaOS Update Client - OTA update system with rollback support.
	  Integrates with RAUC for atomic A/B partition updates.
```

## conf/local.conf
```bitbake
MACHINE = "raspberrypi5"
DISTRO = "straturaOS"
PACKAGE_CLASSES ?= "package_ipk"

# Enable required features
DISTRO_FEATURES_append = " systemd virtualization bluetooth wifi"
VIRTUAL-RUNTIME_init_manager = "systemd"
DISTRO_FEATURES_BACKFILL_CONSIDERED = "sysvinit"
VIRTUAL-RUNTIME_initscripts = ""

# Enable features for OTA and containers
DISTRO_FEATURES_append = " rauc docker"

# Add Docker packages
IMAGE_INSTALL_append = " \
    docker-ce \
    docker-compose \
    python3-docker-compose \
    networkmanager \
    networkmanager-nmcli \
    stratura-supervisor \
    stratura-config \
    openssh-server-sshd \
    wireless-tools \
    wpa-supplicant \
    bluez5 \
    kernel-modules \
    stratura-resinhup \
"

# Custom splash screen
IMAGE_INSTALL_append = " psplash"
SPLASH = "psplash-stratura"

# Enable GPU support for RPi5
GPU_MEM = "256"
ENABLE_DRM = "1"

# System configs
CORE_IMAGE_EXTRA_INSTALL += " \
    packagegroup-core-boot \
    packagegroup-core-ssh-openssh \
"

# Development tools
EXTRA_IMAGE_FEATURES += "debug-tweaks"

# Partition Configuration
STRATURA_BOOTLOADER_PARTITION_SIZE = "40960"
STRATURA_STATE_PARTITION_SIZE = "20480"
STRATURA_DATA_PARTITION_SIZE = "204800"
```
